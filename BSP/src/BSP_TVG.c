/**********************************************************
    Copyright © 2021 Bohai Shenheng Technology Co.Ltd   
     
    @File name: BSP_TVG.h
    @Author:    Fitz
    @Description:
    @Others:
        Data:2022/05/17
        Version:V1.0
        ESP_IDF Version:V4.3.1
    @History:
 
 **********************************************************/

/* Includes ------------------------------------------------------------------*/
#include <stdio.h>
#include <string.h>
#include "freertos/FreeRTOS.h"
#include "freertos/task.h"
#include "esp_spi_flash.h"
#include "esp_err.h"
#include "esp_log.h"
#include "esp_partition.h"
#include "driver/i2s.h"
#include "driver/adc.h"
#include "esp_adc_cal.h"
#include "esp_rom_sys.h"
#include "driver/dac_common.h"
/* Private includes ----------------------------------------------------------*/
/* USER CODE BEGIN Includes */
#include "BSP_TVG.h"


    

/* USER CODE END Includes */

/* Private define ------------------------------------------------------------*/
/* USER CODE BEGIN PD */
//i2s number
#define I2S_NUM           (0)
#define I2S_FORMAT        (I2S_CHANNEL_FMT_ONLY_RIGHT)
//i2s data bits
#define I2S_SAMPLE_BITS   (16)
#define I2S_Fre           (16000)


/* USER CODE END PD */

/* Private variables ---------------------------------------------------------*/
/* USER CODE BEGIN PV */
static const char *TAG = "I2S";
const  TVG_DATA_t TVG_DATE=
{
    .rang_6=80,
    .rang_12=100,
    .rang_24=150,
    .rang_36=200,
    .rang_60=250,
    .rang_90=250,
    .rang_120=250,
};
//20220622  1600个
// const unsigned char tvg_table[1600] = {
// 60,60,65,65,68,68,71,71,74,74,76,76,78,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198
// };
const unsigned char tvg_tableH[1700] = {
60,60,60,60,60,60,60,60,60,60,60,60,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252
};
const unsigned char tvg_tableL[1700] = {
89,89,89,89,89,89,89,89,89,89,89,89,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255
};
/* USER CODE END PV */


/* Private function prototypes -----------------------------------------------*/
/* USER CODE BEGIN PFP */

/* USER CODE END PFP */


/* Private user Task ---------------------------------------------------------*/
/* USER CODE BEGIN 0 */
/* USER CODE END 0 */


/* Private user code ---------------------------------------------------------*/
/* USER CODE BEGIN 0 */
void I2S_DAC_init(void)
{
     int i2s_num = I2S_NUM;
     i2s_config_t i2s_config = {
        .mode = I2S_MODE_MASTER | I2S_MODE_TX | I2S_MODE_DAC_BUILT_IN,
        .sample_rate =  I2S_Fre,
        .bits_per_sample = I2S_SAMPLE_BITS,
        .communication_format = I2S_COMM_FORMAT_STAND_I2S,
        .channel_format = I2S_FORMAT,
        .intr_alloc_flags = 0,
        .dma_buf_count = 4,
        .dma_buf_len =1024,
        .use_apll = 1,
        .tx_desc_auto_clear=1,
     };
     //install and start i2s driver
     i2s_driver_install(i2s_num, &i2s_config, 0, NULL);
     //init DAC pad
     i2s_set_dac_mode(I2S_DAC_CHANNEL_RIGHT_EN);         //IO25
    
}

void TVG_Set(uint8_t *Data,uint32_t Len)
{
    size_t  bytes_written=0;
    i2s_write(I2S_NUM, Data, Len, &bytes_written, portMAX_DELAY);
    i2s_set_clk(0, 10000, 16,1);
}

/*mV=3300*Num/256*/
void SET_GainNum(uint8_t Num)
{
  dac_output_enable(DAC_CHANNEL_1);
  dac_output_voltage(DAC_CHANNEL_1,Num);//增益量
//   ESP_LOGI(TAG,"SET_GainNum=%d",Num);
}

/* USER CODE END 0 */
/*----------------------------------END---------------------------------------*/